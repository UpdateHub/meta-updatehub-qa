## conf/layer.conf
```bitbake
# We have a conf and classes directory, add to BBPATH
BBPATH .= ":${LAYERDIR}"

# We have recipes-* directories, add to BBFILES
BBFILES += "${LAYERDIR}/recipes-*/*/*.bb \
	${LAYERDIR}/recipes-*/*/*.bbappend"

BBFILE_COLLECTIONS += "updatehub-qa"
BBFILE_PATTERN_updatehub-qa = "^${LAYERDIR}/"
BBFILE_PRIORITY_updatehub-qa = "9"

WKS_FILES_uh-qemu-i386 ??= "${MACHINE}.wks"
WKS_SEARCH_PATH_uh-qemu-i386 ??= "${THISDIR}:${@':'.join('%s/wic' % p for p in '${BBPATH}'.split(':'))}:${@':'.join('%s/scripts/lib/wic/canned-wks' % l for l in '${BBPATH}:${COREBASE}'.split(':'))}"

WKS_FILES_uh-qemu-x86-64 ??= "${MACHINE}.wks"
WKS_SEARCH_PATH_uh-qemu-x86-64 ??= "${THISDIR}:${@':'.join('%s/wic' % p for p in '${BBPATH}'.split(':'))}:${@':'.join('%s/scripts/lib/wic/canned-wks' % l for l in '${BBPATH}:${COREBASE}'.split(':'))}"

# Append the build number to
UPDATEHUB_PACKAGE_VERSION_SUFFIX ?= "${@'-build-%s' % BUILD_NUMBER if 'BUILD_NUMBER' in d else ''}"
UPDATEHUB_PACKAGE_VERSION_append = "${UPDATEHUB_PACKAGE_VERSION_SUFFIX}"

# Adjust the polling interval for Q/A use
UPDATEHUB_POLLING_INTERVAL ?= "1m"
```

## conf/machine/uh-qemu-armv5e.conf
```bitbake
#@TYPE: Machine
#@NAME: QEMU ARMv5e
#@DESCRIPTION: Machine configuration using QEMU ARMv5e for U-Boot backend test

MACHINEOVERRIDES =. "qemuarm:"
KMACHINE:pn-linux-yocto = "qemuarma9"
PREFERRED_PROVIDER_virtual/kernel = "linux-yocto"
PREFERRED_PROVIDER_virtual/bootloader = "u-boot-updatehub"

require conf/machine/include/qemu.inc
require conf/machine/include/arm/arch-armv5-dsp.inc

KERNEL_IMAGETYPE = "zImage"
KERNEL_DEVICETREE:uh-qemu-armv5e = "vexpress-v2p-ca9.dtb"

UBOOT_ELF = "u-boot"
UBOOT_SUFFIX = "bin"
UBOOT_MACHINE = "vexpress_ca9x4_defconfig"

SERIAL_CONSOLES = "115200;ttyAMA0"

IMAGE_CLASSES += "image_types_128m-ubifs-nor"
IMAGE_FSTYPES = "ubifs 128m-ubifs-nor"

MKUBIFS_ARGS = "-m 1 -e 262016 -c 1024"
UBINIZE_ARGS = "-p 256KiB -m 1 -O 64"

MACHINE_ESSENTIAL_EXTRA_RDEPENDS:append = " \
    kernel-image kernel-devicetree \
    \
    haveged \
"

# UpdateHub settings
UPDATEHUB_DEVICE_IDENTITY = "primary-iface"
UPDATEHUB_INSTALL_MODE = "ubifs"
UPDATEHUB_FILESYSTEM_SUPPORT = "ubifs"
UPDATEHUB_DEVICE_ATTRIBUTE += "kernel cpu-model mem-total ipinfo-io"
UPDATEHUB_IMAGE_TYPE = "active/inactive"
UPDATEHUB_ACTIVE_INACTIVE_BACKEND = "u-boot"
```

## conf/machine/uh-qemu-i386.conf
```bitbake
#@TYPE: Machine
#@NAME: QEMU i386
#@DESCRIPTION: Machine configuration using QEMU i386 for GRUB EFI backend test

MACHINEOVERRIDES =. "qemux86:"
KMACHINE_pn-linux-yocto = "qemux86"
PREFERRED_PROVIDER_virtual/kernel = "linux-yocto"
PREFERRED_PROVIDER_virtual/bootloader = "u-boot-updatehub"
PREFERRED_PROVIDER_u-boot-fw-utils = "u-boot-updatehub-fw-utils"

require conf/machine/include/qemu.inc
require conf/machine/include/tune-i586.inc

KERNEL_IMAGETYPE = "bzImage"

UBOOT_MACHINE = "qemu-x86_efi_payload32_defconfig"

UBOOT_SUFFIX = "efi"
UBOOT_BINARY = "u-boot-payload.efi"

SERIAL_CONSOLES = "115200;ttyS0"

MACHINE_FEATURES += "x86"

IMAGE_FSTYPES = "tar.xz wic.gz"
IMAGE_DEPENDS_wic_append = " dosfstools-native mtools-native virtual/bootloader"

IMAGE_BOOT_FILES = "u-boot-payload.efi;efi/boot/bootia32.efi"

MACHINE_ESSENTIAL_EXTRA_RDEPENDS_append = " kernel-image"

# UpdateHub settings
UPDATEHUB_DEVICE_IDENTITY = "primary-iface"
UPDATEHUB_INSTALL_MODE = "copy tarball"
UPDATEHUB_FILESYSTEM_SUPPORT = "vfat ext4"
UPDATEHUB_DEVICE_ATTRIBUTE += "kernel cpu-model mem-total"
UPDATEHUB_IMAGE_TYPE = "active/inactive"
UPDATEHUB_ACTIVE_INACTIVE_BACKEND = "u-boot"
```

## conf/machine/uh-qemu-x86-64.conf
```bitbake
#@TYPE: Machine
#@NAME: QEMU x86-64
#@DESCRIPTION: Machine configuration using QEMU x86-64 for GRUB EFI backend test

MACHINEOVERRIDES =. "qemux86-64:"
KMACHINE_pn-linux-yocto = "qemux86-64"
PREFERRED_PROVIDER_virtual/bootloader = "grub-efi"
PREFERRED_PROVIDER_virtual/kernel = "linux-yocto"

require conf/machine/include/qemu.inc
DEFAULTTUNE ?= "core2-64"
require conf/machine/include/tune-core2.inc

KERNEL_IMAGETYPE = "bzImage"

SERIAL_CONSOLES = "115200;ttyS0"

MACHINE_FEATURES += "x86"

IMAGE_FSTYPES = "tar.xz wic.gz"
WKS_FILE_DEPENDS += "dosfstools-native mtools-native updatehub-grub-script"

IMAGE_BOOT_FILES = "grub-efi-bootx64.efi;efi/boot/bootx64.efi \
                    grub.cfg;efi/boot/grub.cfg"

MACHINE_ESSENTIAL_EXTRA_RDEPENDS_append = " \
    kernel-image \
    \
    rng-tools \
"

# UpdateHub settings
UPDATEHUB_DEVICE_IDENTITY = "primary-iface"
UPDATEHUB_INSTALL_MODE = "copy tarball"
UPDATEHUB_FILESYSTEM_SUPPORT = "vfat ext4"
UPDATEHUB_DEVICE_ATTRIBUTE += "kernel cpu-model mem-total"
UPDATEHUB_IMAGE_TYPE = "active/inactive"
UPDATEHUB_ACTIVE_INACTIVE_BACKEND = "grub-efi"
```

## wic/uh-qemu-x86-64.wks
```
part /boot --source bootimg-partition --ondisk vda --fstype=vfat --label boot --active --align 4 --size 4
part / --source rootfs --ondisk vda --fstype=ext4 --label system --fixed-size 1G --align 8192 --extra-space 0
part / --source rootfs --ondisk vda --fstype=ext4 --label system --fixed-size 1G --align 8192 --extra-space 0
part /data --ondisk vda --fstype=ext4 --label data --size 1G --align 8192 --extra-space 0

bootloader --ptable gpt
```
